#include <Helper.h>
#include <Servo.h>
#include <stdio.h>
Helper helper;
 int servoPin = 8;
int cL_stepper_pins[] = {12, 10, 9, 11};
 int cR_stepper_pins[] = {4, 6, 7, 5};
 int image[20][20]={
                    {0, 0, 0, 0, 1, 1, 0, 0, 0, 0, 0, 0, 0, 0, 1, 1, 0, 0, 0, 0, },
                    {0, 0, 1, 1, 1, 1, 1, 1, 0, 0, 0, 0, 1, 1, 1, 1, 1, 1, 0, 0, },
                    {0, 1, 1, 1, 1, 1, 1, 1, 1, 0, 0, 1, 1, 1, 1, 1, 1, 1, 1, 0, },
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                    {0, 0, 0, 0, 0, 0, 0, 0, 0, 0, 1, 0, 0, 0, 0, 0, 0, 0, 0, 0, }
              };

//int image[20][20] = {
//                      {1, 1, 1, 1, 1, 1, 1, 1, 1, 1, 1, 1, 1, 1, 1, 1, 1, 1, 1, 1 },
//                      {1, 1, 1, 1, 1, 1, 1, 1, 1, 1, 1, 0, 0, 0, 0, 1, 1, 1, 1, 1 },
//                      {1, 1, 1, 1, 1, 1, 1, 1, 1, 1, 0, 0, 0, 0, 1, 1, 1, 1, 1, 1 },
//                      {1, 1, 1, 1, 1, 1, 1, 0, 1, 0, 0, 0, 0, 1, 1, 1, 1, 1, 1, 1 },
//                      {1, 1, 1, 1, 1, 1, 1, 1, 0, 0, 0, 0, 1, 1, 1, 1, 1, 1, 1, 1 },
//                      {1, 1, 1, 1, 1, 1, 0, 0, 0, 0, 0, 0, 0, 0, 0, 1, 1, 1, 1, 1 },
//                      {1, 1, 1, 1, 0, 0, 0, 0, 0, 0, 0, 0, 0, 0, 0, 0, 1, 1, 1, 1 },
//                      {1, 1, 1, 1, 0, 0, 0, 0, 0, 0, 0, 0, 0, 0, 0, 0, 1, 1, 1, 1 },
//                      {1, 1, 1, 0, 0, 0, 0, 0, 0, 0, 0, 0, 0, 0, 0, 0, 0, 1, 1, 1 },
//                      {1, 1, 1, 0, 0, 0, 1, 1, 0, 0, 0, 0, 0, 0, 0, 0, 0, 1, 1, 1 },
//                      {1, 1, 1, 0, 0, 0, 0, 0, 0, 0, 0, 0, 0, 0, 0, 0, 0, 1, 1, 1 },
//                      {1, 1, 1, 0, 0, 0, 0, 0, 0, 0, 0, 0, 0, 0, 0, 0, 0, 1, 1, 1 },
//                      {1, 1, 1, 0, 0, 0, 0, 0, 0, 0, 0, 0, 0, 0, 0, 0, 0, 1, 1, 1 },
//                      {1, 1, 1, 1, 0, 0, 0, 0, 0, 0, 0, 0, 0, 0, 0, 0, 1, 1, 1, 1 },
//                      {1, 1, 1, 1, 0, 0, 0, 0, 0, 0, 0, 0, 0, 0, 0, 0, 1, 1, 1, 1 },
//                      {1, 1, 1, 1, 1, 0, 0, 0, 0, 0, 0, 0, 0, 0, 0, 1, 1, 1, 1, 1 },
//                      {1, 1, 1, 1, 1, 1, 0, 0, 0, 0, 0, 0, 0, 0, 1, 1, 1, 1, 1, 1 },
//                      {1, 1, 1, 1, 1, 1, 1, 0, 0, 0, 0, 0, 0, 1, 1, 1, 1, 1, 1, 1 },
//                      {1, 1, 1, 1, 1, 1, 1, 1, 1, 1, 1, 1, 1, 1, 1, 1, 1, 1, 1, 1 },
//                      {1, 1, 1, 1, 1, 1, 1, 1, 1, 1, 1, 1, 1, 1, 1, 1, 1, 1, 1, 1 }
//                    };

int row = 20;
int column = 20;
int dis= 1;
void setup() {
  randomSeed(analogRead(1)); 
  Serial.begin(9600);
  for(int pin=0; pin<4; pin++){
    pinMode(cL_stepper_pins[pin], OUTPUT);
    digitalWrite(cL_stepper_pins[pin], LOW);
    pinMode(cR_stepper_pins[pin], OUTPUT);
    digitalWrite(cR_stepper_pins[pin], LOW);
  }
  helper.penServo.attach(servoPin);
  Serial.println("setup");
 //
 helper.penup();
  delay(1000);
}


void loop(){
  helper.pendown();
  for(int x =0; x < row; x++){
    //helper.pendown();
    for(int y =0; y < column;y++){   
        if(image[x][y]==1){
        helper.pendown();   
          }
        else{
          helper.penup();
          }
      
      if(y == 19){
        helper.penup();
        helper.pendown();
        helper.penup();
        for(int i=1;i <= 19;i++){
          helper.backward(5);
        }
        helper.right(90);
        helper.forward(4);
        helper.left(90);
        helper.forward(2.5);
      }
      else{
        helper.forward(5);
      }
    }
  } 


//
//// pattern #1
//  for(int i=0;i<=100;i++){
//    dis = dis + 5;
//    helper.forward(dis);
//    helper.right(122);
//   
//    
//  }


///// squares
//  for(int i=1;i<=12;i++){
//    
//    helper.forward(40);
//    
//    delay(500);
//    helper.right(90);
//    
//    delay(500);
//   
//    
//  }



    
  while(1);    // wait for reset   
}


